#include "ssd1306.h"
#include <string.h>
#include <stdlib.h>
#include "esp_log.h"

static const char *TAG = "SSD1306";

// Standard 5x7 ASCII Font Table (characters 32 to 127)
static const uint8_t font5x7[][5] = {
    {0x00, 0x00, 0x00, 0x00, 0x00}, //   32
    {0x00, 0x00, 0x5F, 0x00, 0x00}, // ! 33
    {0x00, 0x07, 0x00, 0x07, 0x00}, // " 34
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    {0x08, 0x08, 0x2A, 0x1C, 0x08}  // ~ 126
};

static esp_err_t ssd1306_write_cmd(ssd1306_t *dev, uint8_t cmd) {
    uint8_t buf[2] = {0x00, cmd};
    return i2c_master_transmit(dev->dev_handle, buf, 2, 100);
}

esp_err_t ssd1306_init(i2c_master_bus_handle_t bus_handle, uint8_t dev_addr, ssd1306_t *dev) {
    i2c_device_config_t dev_cfg = {
        .dev_addr_length = I2C_ADDR_BIT_LEN_7,
        .device_address = dev_addr,
        .scl_speed_hz = 400000,
    };
    esp_err_t ret = i2c_master_bus_add_device(bus_handle, &dev_cfg, &dev->dev_handle);
    if (ret != ESP_OK) {
        ESP_LOGE(TAG, "Failed to add SSD1306 to I2C bus: %s", esp_err_to_name(ret));
        return ret;
    }

    const uint8_t init_cmds[] = {
        0xAE,       // Display off
        0xD5, 0x80, // Set display clock divide ratio/oscillator frequency
        0xA8, 0x3F, // Set multiplex ratio (1 to 64) -> 64
        0xD3, 0x00, // Set display offset -> 0
        0x40,       // Set start line address 0
        0x8D, 0x14, // Enable charge pump
        0x20, 0x00, // Set memory addressing mode to Horizontal (0x00)
        0xA1,       // Set segment re-map (col 127 mapped to SEG0)
        0xC8,       // Set COM output scan direction (remapped)
        0xDA, 0x12, // Set COM pins hardware config
        0x81, 0xCF, // Set contrast control
        0xD9, 0xF1, // Set pre-charge period
        0xDB, 0x40, // Set VCOMH deselect level
        0xA4,       // Entire display on resume
        0xA6,       // Normal display (not inverted)
        0xAF        // Display on
    };

    for (size_t i = 0; i < sizeof(init_cmds); i++) {
        ssd1306_write_cmd(dev, init_cmds[i]);
    }

    ssd1306_clear(dev);
    ssd1306_refresh(dev);
    ESP_LOGI(TAG, "SSD1306 128x64 initialized successfully at 0x%02X", dev_addr);
    return ESP_OK;
}

void ssd1306_clear(ssd1306_t *dev) {
    memset(dev->buffer, 0x00, sizeof(dev->buffer));
}

void ssd1306_draw_pixel(ssd1306_t *dev, int16_t x, int16_t y, bool color) {
    if (x < 0 || x >= SSD1306_WIDTH || y < 0 || y >= SSD1306_HEIGHT) return;
    if (color) {
        dev->buffer[x + (y / 8) * SSD1306_WIDTH] |= (1 << (y % 8));
    } else {
        dev->buffer[x + (y / 8) * SSD1306_WIDTH] &= ~(1 << (y % 8));
    }
}

void ssd1306_draw_line(ssd1306_t *dev, int16_t x0, int16_t y0, int16_t x1, int16_t y1, bool color) {
    int16_t dx = abs(x1 - x0), sx = x0 < x1 ? 1 : -1;
    int16_t dy = -abs(y1 - y0), sy = y0 < y1 ? 1 : -1;
    int16_t err = dx + dy, e2;

    while (1) {
        ssd1306_draw_pixel(dev, x0, y0, color);
        if (x0 == x1 && y0 == y1) break;
        e2 = 2 * err;
        if (e2 >= dy) { err += dy; x0 += sx; }
        if (e2 <= dx) { err += dx; y0 += sy; }
    }
}

void ssd1306_fill_rect(ssd1306_t *dev, int16_t x, int16_t y, int16_t w, int16_t h, bool color) {
    for (int16_t i = x; i < x + w; i++) {
        for (int16_t j = y; j < y + h; j++) {
            ssd1306_draw_pixel(dev, i, j, color);
        }
    }
}

static void draw_char(ssd1306_t *dev, int16_t x, int16_t y, char c, bool color, bool invert) {
    if (c < 32 || c > 126) c = '?';
    const uint8_t *glyph = font5x7[c - 32];

    for (int col = 0; col < 5; col++) {
        uint8_t line = glyph[col];
        for (int row = 0; row < 7; row++) {
            bool pixel = (line & (1 << row)) ? true : false;
            if (invert) pixel = !pixel;
            ssd1306_draw_pixel(dev, x + col, y + row, pixel ? color : !color);
        }
    }
    // 1-pixel spacing
    for (int row = 0; row < 7; row++) {
        ssd1306_draw_pixel(dev, x + 5, y + row, invert ? color : !color);
    }
}

void ssd1306_draw_string(ssd1306_t *dev, int16_t x, int16_t y, const char *str, bool color, bool invert) {
    int16_t cur_x = x;
    while (*str) {
        draw_char(dev, cur_x, y, *str, color, invert);
        cur_x += 6;
        str++;
    }
}

void ssd1306_draw_string_scaled(ssd1306_t *dev, int16_t x, int16_t y, const char *str, uint8_t scale, bool color) {
    if (scale < 1) scale = 1;
    int16_t cur_x = x;
    while (*str) {
        char c = *str;
        if (c < 32 || c > 126) c = '?';
        const uint8_t *glyph = font5x7[c - 32];
        for (int col = 0; col < 5; col++) {
            uint8_t line = glyph[col];
            for (int row = 0; row < 7; row++) {
                if (line & (1 << row)) {
                    for (int sx = 0; sx < scale; sx++) {
                        for (int sy = 0; sy < scale; sy++) {
                            ssd1306_draw_pixel(dev, cur_x + col * scale + sx, y + row * scale + sy, color);
                        }
                    }
                }
            }
        }
        cur_x += 6 * scale;
        str++;
    }
}

esp_err_t ssd1306_refresh(ssd1306_t *dev) {
    // Horizontal addressing mode: reset column and page range
    ssd1306_write_cmd(dev, 0x21); // Set column address
    ssd1306_write_cmd(dev, 0);    // Column start 0
    ssd1306_write_cmd(dev, 127);  // Column end 127
    ssd1306_write_cmd(dev, 0x22); // Set page address
    ssd1306_write_cmd(dev, 0);    // Page start 0
    ssd1306_write_cmd(dev, 7);    // Page end 7

    // Send frame buffer in chunks of 128 bytes with 0x40 data prefix
    uint8_t tx_buf[129];
    tx_buf[0] = 0x40; // Data control byte
    for (int p = 0; p < 8; p++) {
        memcpy(&tx_buf[1], &dev->buffer[p * 128], 128);
        esp_err_t ret = i2c_master_transmit(dev->dev_handle, tx_buf, sizeof(tx_buf), 200);
        if (ret != ESP_OK) return ret;
    }
    return ESP_OK;
}

